## mdb-master-esp32s3/main/Kconfig.projbuild
```kconfig
menu "VMC Simulator Configuration"

    config WIFI_SSID
        string "WiFi SSID"
        default ""
        help
            SSID of the WiFi network to connect to.
            Leave empty to start in SoftAP mode only.

    config WIFI_PASSWORD
        string "WiFi Password"
        default ""
        help
            Password for the WiFi network.

endmenu
```

## mdb-slave-esp32s3/main/Kconfig.projbuild
```kconfig
menu "MDB Cashless Device"

    choice
        prompt "Peripheral Addresses"
        default CASHLESS_ADDR_1

        config CASHLESS_ADDR_1
            bool "Cashless Device #1"

        config CASHLESS_ADDR_2
            bool "Cashless Device #2"

    endchoice

    config CASHLESS_DEVICE_ADDRESS
        int
        default 16 if CASHLESS_ADDR_1
        default 96 if CASHLESS_ADDR_2

    choice
        prompt "Country / Currency Code"
        default CURRENCY_UNKNOWN

        config CURRENCY_EUR
            bool "EUR - 0x0978"

        config CURRENCY_USD
            bool "USD - 0x0840"

        config CURRENCY_BRL
            bool "BRL - 0x0986"

        config CURRENCY_UNKNOWN
            bool "UNKNOWN - 0xffff"
    endchoice

    config MDB_CURRENCY_CODE
        int
        default 6520 if CURRENCY_EUR
        default 6208 if CURRENCY_USD
        default 6534 if CURRENCY_BRL
        default 65535 if CURRENCY_UNKNOWN

    choice
        prompt "Scale Factor (MDB)"
        default SCALE_FACTOR_1

        config SCALE_FACTOR_1
            bool "1"

        config SCALE_FACTOR_10
            bool "10"

        config SCALE_FACTOR_100
            bool "100"

    endchoice

    config MDB_SCALE_FACTOR
        int
        default 1 if SCALE_FACTOR_1
        default 10 if SCALE_FACTOR_10
        default 100 if SCALE_FACTOR_100

    config MDB_DECIMAL_PLACES
        int "Decimal Places (MDB)"
        default 2
        range 0 3

    config MDB_SNIFF_OTHER_CASHLESS
        bool "Sniff other cashless device (credit card detection)"
        default y
        help
            Passively listen to MDB traffic addressed to the other cashless
            device (e.g. Nayax credit card terminal). When a vend succeeds
            on that device, a CARD_SALE (0x23) is published via MQTT.
            The sniffed address is automatically set to the opposite of
            this device's address (0x10 ↔ 0x60).
            The device never transmits on the sniffed address.

    config MDB_SNIFF_ADDRESS
        int
        default 96 if CASHLESS_ADDR_1
        default 16 if CASHLESS_ADDR_2

endmenu # MDB Cashless Device

menu "RFID card reader"

    config RFID_READER_ENABLE
        bool "Serial RFID reader on the pulse input"
        default y
        help
            Read a serial RFID reader (F02DC and compatibles) wired to the
            board's pulse input. Every card presented is published to the
            MQTT topic /{company}/{device}/card; the backend answers with
            the card account's balance on the /credit topic.

            No hardware change is needed — the pulse input is routed
            through the GPIO matrix to a spare UART receiver.

    config RFID_UART_PORT
        int "UART port"
        depends on RFID_READER_ENABLE
        default 0
        range 0 2
        help
            UART1 carries DEX telemetry and UART2 the SIM7080G modem, so
            UART0 is the only free port on this board. It is available
            because the console runs over USB-Serial-JTAG.

    config RFID_RX_GPIO
        int "RX GPIO (reader TX -> board pulse input)"
        depends on RFID_READER_ENABLE
        default 13
        help
            GPIO 13 is PIN_PULSE_1 on the production PCB, broken out as
            io13 on the J4 expansion header.

            Wire the reader to that header pin, NOT to the three-pin Pulse
            connector: the connector is an output (it carries the collector
            of Q7, whose base GPIO 13 drives through R27), so nothing on it
            can reach the SoC. The reader's output must also be push-pull —
            R27 parks an undriven line near 0.9 V. Any free GPIO (io1, io2,
            io6 on the slave board) avoids both issues.

    config RFID_BAUD
        int "Baud rate"
        depends on RFID_READER_ENABLE
        default 9600
        help
            F02DC ships at 9600 8N1.

    config RFID_INVERT_RX
        bool "Invert the RX line"
        depends on RFID_READER_ENABLE
        default n
        help
            Enable when the pulse input passes through an inverting buffer
            or optocoupler, so the idle level reaches the SoC as low.

    config RFID_DEDUP_MS
        int "Duplicate suppression window (ms)"
        depends on RFID_READER_ENABLE
        default 5000
        range 250 60000
        help
            These readers repeat the serial for as long as the card sits on
            the antenna. Repeats of the same serial within this window are
            dropped, and each repeat slides the window forward, so one card
            presentation causes exactly one backend request however long
            the card is held there. The card has to be away for this long
            before it counts as a new presentation.

endmenu # RFID card reader

menu "SIM7080G"

    choice
        prompt "LTE Network Mode"
        default SIM7080G_CMNB_BOTH

        config SIM7080G_CMNB_CATM
            bool "Cat-M only"

        config SIM7080G_CMNB_NBIOT
            bool "NB-IoT only"

        config SIM7080G_CMNB_BOTH
            bool "Both (LTE-M + NB-IoT)"

    endchoice

    config SIM7080G_CMNB
        int
        default 1 if SIM7080G_CMNB_CATM
        default 2 if SIM7080G_CMNB_NBIOT
        default 3 if SIM7080G_CMNB_BOTH

    config SIM7080G_APN
        string "Default APN (compile-time fallback)"
        default "internet"
        help
            Default APN baked into the binary. The captive portal in P3
            allows runtime override; this value is only used if no APN is
            saved in NVS.

endmenu # SIM7080G
```
